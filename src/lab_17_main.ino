#include "oled-wing-adafruit.h"
#include "LIS3DH.h"
#include <blynk.h>
#include "MQTT.h"
SYSTEM_THREAD(ENABLED);

void callback(char *topic, byte *payload, unsigned int length);// mqtt stuff
MQTT client("lab.thewcl.com", 1883, callback);
void callback(char *topic, byte *payload, unsigned int length)
{
  char p[length + 1];
  memcpy(p, payload, length);
  p[length] = NULL;
}

OledWingAdafruit display;
LIS3DHSPI accel(SPI, D5, WKP);
int movingX;
int movingY;
const unsigned long PRINT_SAMPLE_PERIOD = 100;
unsigned long lastPrintSample = 0;
volatile bool startGame;
volatile int Timer = 0;

os_thread_t thread1;

void myThread1(void *args) // this thread is used to make the timer
{
  while (1)
  {
    if (startGame)
    {
      Timer = Timer + 1;
      delay(1000);
    }
    else
    {
      Timer = 0;
    }
  }
}

const uint16_t red = D6;
const uint16_t green = D7;
const uint16_t blue = A1;

int x = 5;
int y = 10;
bool chooseJolystick;
bool newGame = false;
bool chooseGame = true;
int maze;

const unsigned char maze1[] PROGMEM = {
    0xFF, 0xFF, 0xFF, 0xFF, 0xFF, 0xFF, 0xFF, 0xFF, 0xFF, 0xFF,
    0x80, 0x00, 0x00, 0x00, 0x00, 0x00, 0x00, 0x00, 0x00, 0xFF,
    0x80, 0x00, 0x00, 0x00, 0x00, 0x00, 0x00, 0x00, 0x00, 0xFF,
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    0xFF, 0xFF, 0xFF, 0xFF, 0xFF, 0xFF, 0xFF, 0xFF, 0xFF, 0xFF};
const unsigned char maze2[] PROGMEM = {
    0xFF, 0xFF, 0xFF, 0xFF, 0xFF, 0xFF, 0xFF, 0xFF, 0xFF,
    0x80, 0x20, 0x00, 0x00, 0x08, 0x40, 0x00, 0x00, 0x1F,
    0x80, 0x20, 0x00, 0x00, 0x08, 0x40, 0x00, 0x00, 0x1F,
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    0xFF, 0xFF, 0xFF, 0xFF, 0xFF, 0xFF, 0xFF, 0xFF, 0xFF};
const unsigned char maze3[] PROGMEM = {
    0xFF, 0xFF, 0xFF, 0xFF, 0xFF, 0xFF, 0xFF, 0xFF, 0xFF, 0xFF, 0xFF, 0xFF, 0xFF, 0xFF,
    0x84, 0x00, 0x00, 0x00, 0x08, 0x00, 0x00, 0x00, 0x00, 0x40, 0x10, 0x00, 0x00, 0x00,
    0x84, 0x00, 0x00, 0x00, 0x08, 0x00, 0x00, 0x00, 0x00, 0x40, 0x10, 0x00, 0x00, 0x00,
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    0xFF, 0xFF, 0xFF, 0xFF, 0xFF, 0xFF, 0xFF, 0xFF, 0xFF, 0xFF, 0xFF, 0xFF, 0xFF, 0xFF};
const unsigned char IoTStart[] PROGMEM = {
    0x00, 0x00, 0x00, 0x00, 0x00, 0x00, 0x00, 0x00, 0x00, 0x00, 0x00, 0x00, 0x00,
    0x00, 0x00, 0x00, 0x00, 0x00, 0x00, 0x00, 0x00, 0x00, 0x00, 0x00, 0x00, 0x00,
    0x00, 0x00, 0x00, 0x00, 0x00, 0x00, 0x00, 0x00, 0x00, 0x00, 0x00, 0x00, 0x00,
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    0x00, 0x00, 0x00, 0x00, 0x00, 0x00, 0x00, 0x00, 0x00, 0x00, 0x00, 0x00, 0x00};
const unsigned char youWin[] PROGMEM = {
    0xFF, 0xFF, 0xFF, 0xFF, 0xFF, 0xFF, 0xFF, 0xFF, 0xFF, 0xFF, 0xFF, 0xFF, 0xF0,
    0xFF, 0xFF, 0xFF, 0xFF, 0xFF, 0xFF, 0xFF, 0xFF, 0xFF, 0xFF, 0xFF, 0xFF, 0xF0,
    0xFF, 0xFF, 0xFF, 0xFF, 0xFF, 0xFF, 0xFF, 0xFF, 0xFF, 0xFF, 0xFF, 0xFF, 0xF0,
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    0xFF, 0xFF, 0xFF, 0xFF, 0xFF, 0xFF, 0xFF, 0xFF, 0xFF, 0xFF, 0xFF, 0xFF, 0xF0};

BLYNK_WRITE(V1) // to get the values from the joystick
{
  int xx = param[0].asInt();
  int yy = param[1].asInt();

  Serial.print("X = ");
  Serial.print(xx);
  Serial.print("; Y = ");
  Serial.println(yy);
  if (chooseJolystick)
  {
    movingY = yy;
    movingX = xx;
  }
}
// setup() runs once, when the device is first turned on.
void setup()
{
  // Put initialization like pinMode and begin functions here.
  Serial.begin(9600);

  pinMode(red, OUTPUT);
  pinMode(green, OUTPUT);
  pinMode(blue, OUTPUT);

  display.setup();
  display.clearDisplay();
  display.display();

  Blynk.begin("KFgwPygKZdZF5I_kkJtpz3rqrdW55Z0J", IPAddress(167, 172, 234, 162), 9090);

  os_thread_create(&thread1, "anyName", OS_THREAD_PRIORITY_DEFAULT, myThread1, NULL, 1024);

  LIS3DHConfig config;
  config.setPositionInterrupt(16);
  bool setupSuccess = accel.setup(config);
  Serial.printlnf("setupSuccess=%d", setupSuccess);
  
  display.clearDisplay();
  display.setTextSize(1);
  display.setTextColor(WHITE);
  display.setCursor(0, 0);
  display.drawBitmap(12, 0, IoTStart, 100, 30, WHITE);
  display.display();
  delay(5000);

}

// loop() runs over and over again, as quickly as it can execute.
void loop()
{
  if (client.isConnected())
  {
    client.loop();
  }
  else
  {
    client.connect(System.deviceID());
  }
  Blynk.run();
  display.loop();

  LIS3DHSample sample;
  while (chooseGame) // the first page (to choose difficulty)
  {
    display.loop();
    display.clearDisplay();
    display.setTextSize(1);
    display.setTextColor(WHITE);
    display.setCursor(0, 0);
    display.println("Choose the difficulty");
    display.println("A: easy difficulty");
    display.println("B: medium difficulty");
    display.println("C: hard difficulty");
    display.display();

    if (display.pressedA())
    {
      maze = 1;
      newGame = true;
      chooseGame = false;
    }
    if (display.pressedB())
    {
      maze = 2;
      newGame = true;
      chooseGame = false;
    }
    if (display.pressedC())
    {
      maze = 3;
      newGame = true;
      chooseGame = false;
    }
  }
  while (newGame) // the page to choose to play with the joystick or accelerometer
  {
    display.loop();
    display.clearDisplay();
    display.setTextSize(1);
    display.setTextColor(WHITE);
    display.setCursor(0, 0);
    display.println("Press A to play with the accelerometer");
    display.println("Press B to play with the Joystick");
    display.display();
    if (display.pressedA())
    {
      chooseJolystick = false;
      newGame = false;
    }
    if (display.pressedB())
    {
      chooseJolystick = true;
      newGame = false;
    }
  }
  if (!newGame) // start a game
  {
    startGame = true;
    if (!chooseJolystick) // to get the values from the accelerometer
    {
      if (millis() - lastPrintSample >= PRINT_SAMPLE_PERIOD)
      {
        lastPrintSample = millis();
        if (accel.getSample(sample))
        {
          Serial.printlnf("%d,%d,%d", sample.x, sample.y, sample.z);
          movingX = sample.x;
          movingY = sample.y + 300;
        }
        else
        {
          Serial.println("no sample");
        }
      }
      movingY = movingY / 2000;
      movingX = movingX / 2000;
    }
    // from here to line 398 is used to calculate x and y and move the dot and check if the pixel that the dot is going to is a wall or the out of the screen
    if (movingY > 0)
    {
      for (size_t i = 0; i < movingY; i++)
      {
        if (display.getPixel(x, y - 1) == 0 && y > 0)
        {
          y = y - 1;
        }
      }
    }
    if (movingX > 0)
    {
      for (size_t i = 0; i < movingX; i++)
      {
        if (display.getPixel(x + 1, y) == 0 && x != 123)
        {
          x = x + 1;
        }
      }
    }
    if (movingY < 0)
    {
      for (int i = 0; i > movingY; i--)
      {
        if (display.getPixel(x, y + 1) == 0 && y != 31)
        {
          y = y + 1;
        }
      }
    }
    if (movingX < 0)
    {
      for (int i = 0; i > movingX; i--)
      {
        if (display.getPixel(x - 1, y) == 0 && x > 0)
        {
          x = x - 1;
        }
      }
    }
    // from this line to 417 is used to display the maze and the dot
    display.clearDisplay();
    display.setTextSize(1);
    display.setTextColor(WHITE);
    display.drawPixel(x, y, WHITE);
    if (maze == 1)
    {
      display.drawBitmap(25, 0, maze1, 73, 32, WHITE);
    }
    if (maze == 2)
    {
      display.drawBitmap(25, 0, maze2, 72, 32, WHITE);
    }
    if (maze == 3)
    {
      display.drawBitmap(10, 0, maze3, 112, 32, WHITE);
    }
    display.display();
    delay(200);
    if (x == 123) // if the player finishes the maze it sends a message with the time he spent on the maze 
    {
      String timeTaken = String(Timer) + "s";
      startGame = false;
      if (maze == 1)
      {
        client.publish("The Maze", "abdurrahman just completed the easy maze in");
        client.publish("The Maze", timeTaken);
      }
      if (maze == 2)
      {
        client.publish("The Maze", "abdurrahman just completed the medium maze in");
        client.publish("The Maze", timeTaken);
      }
      if (maze == 3)
      {
        client.publish("The Maze", "abdurrahman just completed the hard maze in");
        client.publish("The Maze", timeTaken);
      }
      display.clearDisplay();
      display.setTextSize(1);
      display.setTextColor(WHITE);
      display.setCursor(0, 0);
      display.drawBitmap(12, 0, youWin, 100, 32, WHITE); // and display this message
      display.display();
      // and cycle through a few colors in the RGB LED
      analogWrite(red, 255); //red
      analogWrite(green, 0);
      analogWrite(blue, 0);
      delay(700);
      analogWrite(red, 0); //green
      analogWrite(green, 255);
      delay(700);
      analogWrite(green, 0);
      analogWrite(blue, 255); //blue
      delay(700);
      analogWrite(red, 255);
      analogWrite(green, 20);
      analogWrite(blue, 0); //yellow
      delay(700);
      analogWrite(green, 150); //orange
      delay(700);
      analogWrite(green, 0);
      analogWrite(blue, 255); //purple
      delay(700);
      analogWrite(red, 0);
      analogWrite(green, 255); //cyan
      delay(700);
      analogWrite(red, 0); // reset colors
      analogWrite(green, 0);
      analogWrite(blue, 0);
      newGame = false;
      chooseGame = true;
      x = 10; // reset x and y for the next game
      y = 10;
      movingX = 0;
      movingY = 0;
    }
    // The core of your code will likely live here.
  }
}